AUTOSAR XML
3 x :
  >ContainerA  # >BB
  >ContainerB  # >AA
  >ContainerC  # >CC
